## conf/machine/clearfog.conf
```bitbake
include conf/machine/include/tune-cortexa9.inc

DEFAULTTUNE_armada38x ?= "armv7ahf-neon"

MACHINEOVERRIDES =. "armada38x:"

UBOOT_MACHINE = "clearfog_defconfig"
UBOOT_BINARY = "u-boot-spl.kwb"
UBOOT_EXTLINUX = "1"
UBOOT_EXTLINUX_ROOT = "root=/dev/mmcblk0p1"
UBOOT_EXTLINUX_CONSOLE = "console=${console}"
do_image_wic[depends] += "u-boot:do_populate_sysroot virtual/kernel:do_deploy"

PREFERRED_PROVIDER_virtual/kernel = "linux-yocto-clearfog"
KBUILD_DEFCONFIG_armada38x = "mvebu_v7_defconfig"

IMAGE_INSTALL_append = " \
	u-boot \
	kernel-devicetree \
	kernel-image-zimage \
	kernel-modules \
	"

# Device boot tartget
#
# Options (case-sensitive):
# - sdhc	(SD Card) (default)
# - emmc	(eMMC)
# - spi
# - uart	(Serial)
# - m.2		(M.2 SSD)
#
# Note: Only sdhc and emmc tested, others settings default to sdhc
BOOT_MEDIA ?= "sdhc"

SERIAL_CONSOLE = "115200;ttyS0"

IMAGE_FSTYPES ?= "tar.bz2 ext4 wic"

WKS_FILE ?= "sdimage-clearfog.wks"
```
